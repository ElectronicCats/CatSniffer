/**
 * @cliArgs --board "/ti/boards/LP_CC1352P7_1" --product "simplelink_cc13x2_26x2_sdk@5.10.00.48"
 * @versions {"tool":"1.16.1+2960"}
 */

/**
 * Import the modules used in this configuration.
 */
const CCFG     = scripting.addModule("/ti/devices/CCFG");
const rfdesign = scripting.addModule("/ti/devices/radioconfig/rfdesign");
const GPIO     = scripting.addModule("/ti/drivers/GPIO");
const GPIO1    = GPIO.addInstance();
const GPIO2    = GPIO.addInstance();
const Power    = scripting.addModule("/ti/drivers/Power");
const RF       = scripting.addModule("/ti/drivers/RF");
const RTOS     = scripting.addModule("/ti/drivers/RTOS");
const UART     = scripting.addModule("/ti/drivers/UART", {}, false);
const UART1    = UART.addInstance();

/**
 * Write custom configuration values to the imported modules.
 */
CCFG.enableBootloaderBackdoor = true;
CCFG.dioBootloaderBackdoor    = 15;
CCFG.levelBootloaderBackdoor  = "Active low";
CCFG.xoscCapArray             = true;
CCFG.xoscCapArrayDelta        = 0xD5;
CCFG.enableBootloader         = true;
CCFG.ccfgTemplate.$name       = "ti_devices_CCFGTemplate0";

GPIO1.$name                      = "CONFIG_GPIO_GLED";
GPIO1.mode                       = "Output";
GPIO1.outputStrength             = "High";
GPIO1.pinInstance.$name          = "CONFIG_PIN_GLED";
GPIO1.pinInstance.outputStrength = "Maximum";
GPIO1.gpioPin.$assign            = "boosterpack.6";

GPIO2.$name             = "CONFIG_GPIO_RLED";
GPIO2.pinInstance.$name = "CONFIG_PIN_RLED";
GPIO2.gpioPin.$assign   = "boosterpack.24";

Power.enablePolicy = false;

RF.$hardware = system.deviceData.board.components["SKY13317-373LF"];

UART1.$name               = "CONFIG_UART_0";
UART1.$hardware           = system.deviceData.board.components.XDS110UART;
UART1.txPinInstance.$name = "CONFIG_PIN_0";
UART1.rxPinInstance.$name = "CONFIG_PIN_1";
UART1.uart.txPin.$assign  = "boosterpack.4";
UART1.uart.rxPin.$assign  = "boosterpack.3";

/**
 * Pinmux solution for unlocked pins/peripherals. This ensures that minor changes to the automatic solver in a future
 * version of the tool will not impact the pinmux you originally saw.  These lines can be completely deleted in order to
 * re-solve from scratch.
 */
RF.rfAntennaPin0.$suggestSolution = "DIO_28";
RF.rfAntennaPin1.$suggestSolution = "DIO_29";
RF.rfAntennaPin2.$suggestSolution = "DIO_30";
UART1.uart.$suggestSolution       = "UART0";
